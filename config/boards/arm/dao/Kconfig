## config/boards/arm/dao/Kconfig
```kconfig
# Copyright (c) 2021 Rafael Yumagulov
# SPDX-License-Identifier: MIT

CONFIG_ZMK_IDLE_TIMEOUT=3600000
CONFIG_ZMK_IDLE_SLEEP_TIMEOUT=7200000
CONFIG_BT_CTLR_TX_PWR_PLUS_8=y

config BOARD_ENABLE_DCDC
	bool "Enable DCDC mode"
	select SOC_DCDC_NRF52X
	default y
	depends on (BOARD_DAO_LEFT || BOARD_DAO_RIGHT)
```

## config/west.yml
```yaml
manifest:
  remotes:
    - name: Drey
      url-base: https://github.com/Drey
  projects:
    - name: zmk
      remote: Drey
      revision: dao
      import: app/west.yml
  self:
    path: config
```
